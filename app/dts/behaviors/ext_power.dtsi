/*
 * Copyright (c) 2020 The ZMK Contributors
 *
 * SPDX-License-Identifier: MIT
 */

/ {
    behaviors {
        ext_power: behavior_ext_power {
            compatible = "zmk,behavior-ext-power";
            label = "EXTPOWER";
            #binding-cells = <1>;
            behavior-id = <BEHAVIOR_EXT_POWER>;
        };
    };
};
