/*
 * Copyright (c) 2020 The ZMK Contributors
 *
 * SPDX-License-Identifier: MIT
 */

/ {
    behaviors {
        rgb_ug: behavior_rgb_underglow {
            compatible = "zmk,behavior-rgb-underglow";
            label = "RGB_UG";
            #binding-cells = <2>;
            behavior-id = <BEHAVIOR_RGB_UNDERGLOW>;
        };
    };
};
