## app/dts/bindings/animations/zmk,animation-indicator.yaml
```yaml
# Copyright (c) 2024, The ZMK Contributors
# SPDX-License-Identifier: MIT

description: |
  Indicator animation. Sets a pixel zone a solid color if the key selected
  by this binding is pressed, and turns off the zone if not.

compatible: "zmk,animation-indicator"

include: animation_base.yaml

properties:
  key:
    type: int
    required: true
    description: |
      Keycode that the indicator should track the state of

  color:
    type: int
    required: true
    description: |
      Indicator color
```

## app/dts/bindings/behaviors/one_param.yaml
```yaml
# Copyright (c) 2020 The ZMK Contributors
# SPDX-License-Identifier: MIT

properties:
  label:
    type: string
    required: true
  "#binding-cells":
    type: int
    required: true
    const: 1
  behavior-id:
    type: int
    required: true

binding-cells:
  - param1
```

## app/dts/bindings/zmk,animation.yaml
```yaml
# Copyright (c) 2020, The ZMK Contributors
# SPDX-License-Identifier: MIT

description: Global animation configuration

compatible: "zmk,animation"

properties:
  drivers:
    type: phandles
    required: true
    description: |
      This array should contain all driver devices responsible for illuminating animated LEDs.
      The devices must implement Zephyr's LED Strip Interface and expose a chain-length devicetree property.

  pixels:
    type: phandle-array
    required: true
    description: |
      This field contains the pixel configuration for the entire board.
      The order of this array determines in what order pixels are sent to the driver device API.
      If multiple driving devices are used, their chain-length property determines the size of the buffer for each device.

  key-pixels:
    type: array
    required: false
    description: |
      Use this field to specify the pixel index corresponding to each key
      following the order used in your keymap.
      When left unspecified, the driver assumes that for every key, the pixel has a matching id.
      So for N keys, the first N pixels are exactly in the same order as keys in your keymap.

  chain-lengths:
    type: array
    required: false
    description: |
      This field can be used if the LED driver nodes for your LED controllers
      do not specify chain-length properties. The indices of the chain lengths
      used here must match the chain lengths desired for each LED driver.

  chain-reserved-ranges:
    type: array
    description: |
      If not all the pixels at offsets 0...N-1 are usable for a chain length of
      N, this property contains a set of tuples specifying which ranges are
      not used. The animation code will skip pixel calculations for these
      ranges. Note that the "pixels" property should be set to an array
      of pixels accounting for these reserved ranges.

      For example, setting "chain-reserved-ranges = <3 2>, <10 1>;" means that
      offsets 3,4 and 10 in the LED driver buffer will not be populated with
      pixel data, and should be skipped in the "pixels" property.
```
